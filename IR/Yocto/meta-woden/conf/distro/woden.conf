## IR/Yocto/meta-woden/conf/distro/woden.conf
```bitbake
DISTRO = "woden"
DISTRO_NAME = "Woden"
DISTRO_VERSION = "0.0"
DISTRO_CODENAME = "master"

INIT_MANAGER = "systemd"
DISTRO_FEATURES = "acl argp ext2 ipv4 ipv6 largefile usbhost wifi xattr pci vfat seccomp"
DISTRO_FEATURES_BACKFILL_CONSIDERED = "pulseaudio gobject-introspection-data"

# TODO remove?
DISTRO_EXTRA_RDEPENDS += "packagegroup-core-boot"
DISTRO_EXTRA_RRECOMMENDS += "kernel-module-af-packet"

PREMIRRORS ??= "\
bzr://.*/.*   https://downloads.yoctoproject.org/mirror/sources/ \n \
cvs://.*/.*   https://downloads.yoctoproject.org/mirror/sources/ \n \
git://.*/.*   https://downloads.yoctoproject.org/mirror/sources/ \n \
gitsm://.*/.* https://downloads.yoctoproject.org/mirror/sources/ \n \
hg://.*/.*    https://downloads.yoctoproject.org/mirror/sources/ \n \
osc://.*/.*   https://downloads.yoctoproject.org/mirror/sources/ \n \
p4://.*/.*    https://downloads.yoctoproject.org/mirror/sources/ \n \
svn://.*/.*   https://downloads.yoctoproject.org/mirror/sources/ \n"

require conf/distro/include/no-static-libs.inc
require conf/distro/include/yocto-uninative.inc
require conf/distro/include/security_flags.inc
INHERIT += "uninative"

BB_SIGNATURE_HANDLER ?= "OEEquivHash"
BB_HASHSERVE ??= "auto"

#grub-efi
EFI_PROVIDER = "grub-efi"

# Suffixing the build directory with the libc is pointless
TCLIBCAPPEND = ""
PREFERRED_VERSION_linux-yocto = "5.15%"
PREFERRED_VERSION_fwts = "22.07.00"
```

## IR/Yocto/meta-woden/conf/layer.conf
```bitbake
# We have a conf and classes directory, add to BBPATH
BBPATH .= ":${LAYERDIR}"

# We have recipes-* directories, add to BBFILES
BBFILES += "${LAYERDIR}/recipes-*/*/*.bb \
            ${LAYERDIR}/recipes-*/*/*.bbappend"

BBFILE_COLLECTIONS += "meta-woden"
BBFILE_PATTERN_meta-woden = "^${LAYERDIR}/"
BBFILE_PRIORITY_meta-woden = "5"

LAYERDEPENDS_meta-woden = "core meta-arm openembedded-layer"
LAYERSERIES_COMPAT_meta-woden = "mickledore"

IMAGE_INSTALL:append = " optee-client "
IMAGE_INSTALL:append=" kernel-selftest "
PACKAGECONFIG_pn-kernel-selftest="dt"
```

## SystemReady-devicetree-band/Yocto/meta-woden/conf/distro/woden.conf
```bitbake
DISTRO = "woden"
DISTRO_NAME = "Woden"
DISTRO_VERSION = "0.0"
DISTRO_CODENAME = "master"

INIT_MANAGER = "systemd"
DISTRO_FEATURES = "acl argp ext2 ipv4 ipv6 largefile usbhost wifi xattr pci vfat seccomp polkit"
DISTRO_FEATURES_BACKFILL_CONSIDERED = "pulseaudio gobject-introspection-data"

# TODO remove?
DISTRO_EXTRA_RDEPENDS += "packagegroup-core-boot"
DISTRO_EXTRA_RRECOMMENDS += "kernel-module-af-packet"

# shipping wired-network drivers
MACHINE_ESSENTIAL_EXTRA_RRECOMMENDS  += "kernel-module-ipa \
                                     kernel-module-tap \
                                     kernel-module-pegasus \
                                     kernel-module-smsc75xx \
                                     kernel-module-usbnet \
                                     kernel-module-asix \
                                     kernel-module-rtl8150 \
                                     kernel-module-cdc_ncm \
                                     kernel-module-cdc_subset \
                                     kernel-module-cdc_ether \
                                     kernel-module-smsc95xx \
                                     kernel-module-plusb \
                                     kernel-module-sr9800 \
                                     kernel-module-r8153_ecm \
                                     kernel-module-mcs7830 \
                                     kernel-module-zaurus \
                                     kernel-module-dm9601 \
                                     kernel-module-net1080 \
                                     kernel-module-lan78xx \
                                     kernel-module-ax88179_178a \
                                     kernel-module-r8152 \
                                     kernel-module-mdio \
                                     kernel-module-macvlan \
                                     kernel-module-marvell10g \
                                     kernel-module-bcm7xxx \
                                     kernel-module-smsc \
                                     kernel-module-ax88796b \
                                     kernel-module-broadcom \
                                     kernel-module-bcm-phy-lib \
                                     kernel-module-marvell \
                                     kernel-module-meson-gxl \
                                     kernel-module-bcm54140 \
                                     kernel-module-microchip \
                                     kernel-module-mdio-bcm-unimac \
                                     kernel-module-mdio-mux-meson-g12a \
                                     kernel-module-flexcan \
                                     kernel-module-rcar_can \
                                     kernel-module-rcar_canfd \
                                     kernel-module-can-dev \
                                     kernel-module-mcp251xfd \
                                     kernel-module-macvtap \
                                     kernel-module-mlx4_en \
                                     kernel-module-mlx4_core \
                                     kernel-module-mlx5_core \
                                     kernel-module-bnx2x \
                                     kernel-module-bcmsysport \
                                     kernel-module-genet \
                                     kernel-module-qcom-emac \
                                     kernel-module-rmnet \
                                     kernel-module-r8169 \
                                     kernel-module-mscc_ocelot_switch_lib \
                                     kernel-module-dwmac-meson \
                                     kernel-module-dwmac-ipq806x \
                                     kernel-module-dwmac-generic \
                                     kernel-module-stmmac \
                                     kernel-module-dwmac-imx \
                                     kernel-module-dwmac-altr-socfpga \
                                     kernel-module-dwmac-qcom-ethqos \
                                     kernel-module-dwmac-meson8b \
                                     kernel-module-dwmac-sun8i \
                                     kernel-module-dwmac-rk \
                                     kernel-module-dwmac-visconti \
                                     kernel-module-dwmac-sunxi \
                                     kernel-module-stmmac-platform \
                                     kernel-module-atl1c \
                                     kernel-module-veth \
                                     kernel-module-pcs_xpcs \
                                     kernel-module-bcm-sf2 \
                                     kernel-module-b53_common \
                                     kernel-module-b53_srab \
                                     kernel-module-mscc_felix \
"

PREMIRRORS ??= "\
bzr://.*/.*   https://downloads.yoctoproject.org/mirror/sources/ \n \
cvs://.*/.*   https://downloads.yoctoproject.org/mirror/sources/ \n \
git://.*/.*   https://downloads.yoctoproject.org/mirror/sources/ \n \
gitsm://.*/.* https://downloads.yoctoproject.org/mirror/sources/ \n \
hg://.*/.*    https://downloads.yoctoproject.org/mirror/sources/ \n \
osc://.*/.*   https://downloads.yoctoproject.org/mirror/sources/ \n \
p4://.*/.*    https://downloads.yoctoproject.org/mirror/sources/ \n \
svn://.*/.*   https://downloads.yoctoproject.org/mirror/sources/ \n"

require conf/distro/include/no-static-libs.inc
require conf/distro/include/yocto-uninative.inc
require conf/distro/include/security_flags.inc
INHERIT += "uninative"

BB_SIGNATURE_HANDLER ?= "OEEquivHash"
BB_HASHSERVE ??= "auto"

#grub-efi
EFI_PROVIDER = "grub-efi"

# Suffixing the build directory with the libc is pointless
TCLIBCAPPEND = ""
PREFERRED_VERSION_linux-yocto = "6.16%"
PREFERRED_VERSION_fwts = "25.09.00"
PREFERRED_VERSION_python3-dtschema = "2025.2"
PREFERRED_VERSION_grub = "2.06"
PREFERRED_VERSION_grub-efi = "2.06"
PREFERRED_VERSION_grub-native = "2.06"
PREFERRED_VERSION_python3-jsonschema = "4.17.3"
PREFERRED_VERSION_python3-dtschema-native = "2025.2"
```

## SystemReady-devicetree-band/Yocto/meta-woden/conf/layer.conf
```bitbake
# We have a conf and classes directory, add to BBPATH
BBPATH .= ":${LAYERDIR}"

# We have recipes-* directories, add to BBFILES
BBFILES += "${LAYERDIR}/recipes-*/*/*.bb \
            ${LAYERDIR}/recipes-*/*/*.bbappend"

BBFILE_COLLECTIONS += "meta-woden"
BBFILE_PATTERN_meta-woden = "^${LAYERDIR}/"
BBFILE_PRIORITY_meta-woden = "5"

LAYERDEPENDS_meta-woden = "core meta-arm openembedded-layer"
LAYERSERIES_COMPAT_meta-woden = "scarthgap"

IMAGE_INSTALL:append = " optee-client "
IMAGE_INSTALL:append=" kernel-selftest "
IMAGE_INSTALL:append=" findutils "
PACKAGECONFIG_pn-kernel-selftest="dt"
```

## common/config/buildroot/arm_systemready_defconfig
```kconfig
BR2_aarch64=y
BR2_TOOLCHAIN_BUILDROOT_GLIBC=y
BR2_KERNEL_HEADERS_5_13=y
BR2_ROOTFS_OVERLAY="rootfs-overlay"
BR2_LINUX_KERNEL=y
BR2_LINUX_KERNEL_USE_CUSTOM_CONFIG=y
BR2_LINUX_KERNEL_CUSTOM_CONFIG_FILE="board/arm/system-ready/kernel.config"
BR2_PACKAGE_FWTS=y
BR2_PACKAGE_FWTS_EFI_RUNTIME_MODULE=y
BR2_PACKAGE_TROUSERS=y
BR2_PACKAGE_EFIVAR=y
BR2_PACKAGE_TPM2_TOOLS=y
BR2_TARGET_ROOTFS_CPIO=y
# BR2_TARGET_ROOTFS_TAR is not set
```

## common/config/buildroot_defconfig
```kconfig
# Architecture
BR2_aarch64=y


# Toolchain
BR2_TOOLCHAIN_BUILDROOT_GLIBC=y
BR2_TOOLCHAIN_BUILDROOT_CXX=y

# Additional system packages
BR2_PACKAGE_BUSYBOX_SHOW_OTHERS=y
BR2_PACKAGE_PCIUTILS=y
BR2_PACKAGE_DTC=y
BR2_PACKAGE_DTC_PROGRAMS=y
BR2_PACKAGE_LIBEVENT=y
BR2_PACKAGE_BASH=y
BR2_PACKAGE_SCREEN=y
BR2_PACKAGE_VIM=y
BR2_PACKAGE_KVMTOOL=y
BR2_PACKAGE_DMIDECODE=y
BR2_PACKAGE_EFIBOOTMGR=y
BR2_PACKAGE_ETHTOOL=y
BR2_PACKAGE_LIBZLIB=y
BR2_PACKAGE_ZLIB=y

# python packages
BR2_PACKAGE_PYTHON3=y
BR2_PACKAGE_PYTHON_PACKAGING=y
BR2_PACKAGE_PYTHON3_CURSES=y
BR2_PACKAGE_LIBXML2=y
BR2_PACKAGE_PYTHON_PYYAML=y
BR2_PACKAGE_PYTHON_CHARDET=y
BR2_PACKAGE_PYTHON_MATPLOTLIB=y
BR2_PACKAGE_PYTHON_NUMPY=y
BR2_PACKAGE_PYTHON_NUMPY_ARCH_SUPPORTS=y
BR2_INSTALL_LIBSTDCPP=y
BR2_PACKAGE_PYTHON_JINJA2=y
BR2_PACKAGE_PYTHON_LXML=y
BR2_PACKAGE_PYTHON_PIP=y
BR2_PACKAGE_PYTHON_PILLOW=y
BR2_PACKAGE_LSHW=y

#FWTS package
BR2_PACKAGE_FWTS=y
BR2_PACKAGE_FWTS_EFI_RUNTIME_MODULE=y

# Target filesystem
BR2_TARGET_ROOTFS_CPIO=y

#Additional packages
BR2_ROOTFS_OVERLAY="root_fs_overlay"

# Network manager and nmcli tool
BR2_PACKAGE_EUDEV=y
BR2_ROOTFS_DEVICE_CREATION_DYNAMIC_EUDEV=y
BR2_STATIC_LIBS=n
BR2_USE_MMU=y
BR2_PACKAGE_HAS_UDEV=y
BR2_TOOLCHAIN_GCC_AT_LEAST_4_9=y
BR2_TOOLCHAIN_HEADERS_AT_LEAST_4_6=y
BR2_TOOLCHAIN_USES_GLIBC=y
BR2_TOOLCHAIN_HAS_THREADS=y
BR2_USE_WCHAR=y
BR2_PACKAGE_NETWORK_MANAGER=y
BR2_PACKAGE_READLINE=y

# additional linux utilities
BR2_PACKAGE_UTIL_LINUX_BINARIES=y
BR2_PACKAGE_OPENSSH=y
BR2_PACKAGE_ZIP=y
BR2_PACKAGE_UTIL_LINUX=y
BR2_PACKAGE_UTIL_LINUX_HWCLOCK=y
BR2_PACKAGE_COREUTILS=y

#Packages for BBSR
BR2_PACKAGE_TROUSERS=y
BR2_PACKAGE_OPTEE_CLIENT=y
BR2_PACKAGE_EFIVAR=y
BR2_PACKAGE_TPM2_TOOLS=y

#Packages for ACPICA
BR2_PACKAGE_ACPICA=y

# Packages for SBMR
BR2_PACKAGE_PYTHON3_ZLIB=y
BR2_PACKAGE_PYTHON3_PYEXPAT=y
BR2_PACKAGE_PYTHON_REQUESTS=y
BR2_PACKAGE_PYTHON_REDFISH=y
BR2_PACKAGE_PYTHON_REDFISHTOOL=y
BR2_PACKAGE_PYTHON_PARAMIKO=y
BR2_PACKAGE_PYTHON_CLICK=y
BR2_PACKAGE_PYTHON_ROBOTFRAMEWORK=y
BR2_PACKAGE_PYTHON_ROBOTFRAMEWORK_REQUESTS=y
BR2_PACKAGE_PYTHON_ROBOTFRAMEWORK_SSHLIBRARY=y
BR2_PACKAGE_PYTHON_ROBOTFRAMEWORK_SCPLIBRARY=y
BR2_PACKAGE_PYTHON_SIX=y

#redfish
BR2_PACKAGE_PYTHON_REQUESTS_TOOLBELT=y
BR2_PACKAGE_PYTHON_DECORATOR=y
BR2_PACKAGE_PYTHON_PLY=y
BR2_PACKAGE_PYTHON_JSONPATH_RW=y
BR2_PACKAGE_PYTHON_JSONPOINTER=y
BR2_PACKAGE_PYTHON_PBR=y
BR2_PACKAGE_PYTHON_WHEEL=y
BR2_PACKAGE_PYTHON_REQUESTS_UNIXSOCKET=y

# paramiko
BR2_PACKAGE_HOST_RUSTC_TARGET_ARCH_SUPPORTS=y
BR2_PACKAGE_PYTHON_BCRYPT=y
BR2_PACKAGE_PYTHON_CRYPTOGRAPHY=y
BR2_PACKAGE_PYTHON_PYNACL=y
BR2_PACKAGE_PYTHON_SCP=y

# requests
BR2_PACKAGE_PYTHON_CERTIFI=y
BR2_PACKAGE_PYTHON_CHARSET_NORMALIZER=y
BR2_PACKAGE_PYTHON_IDNA=y
BR2_PACKAGE_PYTHON_URLLIB3=y
BR2_PACKAGE_PYTHON3_SSL=y

# IPMI
BR2_PACKAGE_IPMITOOL=y

# WGET
BR2_PACKAGE_WGET=y

# Redfish Finder
BR2_PACKAGE_REDFISH_FINDER=y

# SCP
BR2_PACKAGE_DROPBEAR=y
BR2_PACKAGE_OPENSSH_SERVER=y
```

## common/config/buildroot_sbsa_defconfig
```kconfig
# Architecture
BR2_aarch64=y


# Toolchain
BR2_TOOLCHAIN_BUILDROOT_GLIBC=y
BR2_TOOLCHAIN_BUILDROOT_CXX=y

#Additional packages
BR2_PACKAGE_PYTHON3=y
BR2_PACKAGE_PYTHON_PACKAGING=y
BR2_PACKAGE_PYTHON3_CURSES=y
BR2_PACKAGE_LIBXML2=y
BR2_PACKAGE_PYTHON_PYYAML=y
BR2_PACKAGE_PYTHON_CHARDET=y
BR2_PACKAGE_PYTHON_MATPLOTLIB=y
BR2_PACKAGE_PYTHON_NUMPY=y
BR2_PACKAGE_PYTHON_NUMPY_ARCH_SUPPORTS=y
BR2_INSTALL_LIBSTDCPP=y
BR2_PACKAGE_PYTHON_JINJA2=y
BR2_PACKAGE_PYTHON_LXML=y
BR2_PACKAGE_PYTHON_PILLOW=y
BR2_PACKAGE_PYTHON_WHEEL=y
BR2_PACKAGE_PYTHON3_ZLIB=y
BR2_PACKAGE_PYTHON3_PYEXPAT=ys
BR2_PACKAGE_PYTHON3_SSL=y
```

## common/config/srband_defconfig
```kconfig
CONFIG_ARCH_BCM4908=y
CONFIG_ARM64_VA_BITS_48=y
CONFIG_ARM_CPUIDLE=y
CONFIG_ARM64_CRYPTO=y
CONFIG_PCI_IMX6=y
CONFIG_MARVELL_10G_PHY=m
CONFIG_USB_NET_DRIVERS=y
CONFIG_USB_USBNET=y
CONFIG_USB_NET_CDC_SUBSET_ENABLE=y
CONFIG_USB_NET_CDC_SUBSET=y
CONFIG_USB_NET_RNDIS_HOST=y
CONFIG_IPMI_HANDLER=y
CONFIG_IPMI_DEVICE_INTERFACE=y
CONFIG_IPMI_SI=y
CONFIG_IPMI_SSIF=y
CONFIG_IPMI_IPMB=y
CONFIG_I2C_BCM2835=y
CONFIG_MFD_RK808=y
CONFIG_TEGRA186_GPC_DMA=m
CONFIG_VIDEO_IMX_MEDIA=m
CONFIG_COMMON_CLK_NPCM8XX=y
CONFIG_MSM_MMCC_8996=y
CONFIG_ARCH_R8A77950=y
CONFIG_ARM_IMX_BUS_DEVFREQ=m
CONFIG_MTK_EFUSE=y
CONFIG_QCOM_QFPROM=y
CONFIG_ROCKCHIP_EFUSE=y
CONFIG_UNIPHIER_EFUSE=y
CONFIG_MESON_EFUSE=m
CONFIG_INTERCONNECT_IMX=m
CONFIG_INTERCONNECT_QCOM_SC7180=m
CONFIG_INTERCONNECT_QCOM_SM8250=m
CONFIG_INTERCONNECT_QCOM_SM8450=m
CONFIG_EXT2_FS=y
CONFIG_EXT3_FS=y
CONFIG_AUTOFS4_FS=y
CONFIG_USB_NET_CDC_EEM=y
CONFIG_PREEMPT=y
CONFIG_PREEMPT_VOLUNTARY=y
CONFIG_RCU_NOCB_CPU=y

# Configurations to enable rshim support
CONFIG_MLXBF_TMFIFO=y

# Configurations to increase serial ports
CONFIG_SERIAL_8250_NR_UARTS=32
CONFIG_SERIAL_8250_RUNTIME_UARTS=32

# Configurations for ethtool and block device testing
CONFIG_BLK_DEV_RAM=y
CONFIG_BLK_DEV_RAM_COUNT=16
CONFIG_BLK_DEV_RAM_SIZE=4096
CONFIG_INET=y
CONFIG_IPV6=y
CONFIG_IPV6_ROUTER_PREF=y
CONFIG_NETDEVICES=y
CONFIG_DUMMY=m
CONFIG_TUN=y
CONFIG_VETH=y
CONFIG_VLAN_8021Q=y
CONFIG_BRIDGE=y
CONFIG_MACVLAN=y
CONFIG_IPVLAN=y
CONFIG_MLX5_CORE=y
CONFIG_MLX5_CORE_EN=y
CONFIG_NET_VENDOR_MELLANOX=y
CONFIG_USB_NET_DRIVERS=y
CONFIG_USB_USBNET=y
CONFIG_USB_NET_CDCETHER=y
CONFIG_USB_NET_CDC_EEM=y
CONFIG_USB_NET_CDC_NCM=y
CONFIG_USB_NET_RNDIS_HOST=y
CONFIG_USB_NET_AX88179_178A=y
CONFIG_USB_NET_SMSC75XX=y
CONFIG_USB_NET_SMSC95XX=y
CONFIG_USB=y
CONFIG_USB_SUPPORT=y
CONFIG_USB_EHCI_HCD=y
CONFIG_USB_XHCI_HCD=y
CONFIG_USB_COMMON=y
```
