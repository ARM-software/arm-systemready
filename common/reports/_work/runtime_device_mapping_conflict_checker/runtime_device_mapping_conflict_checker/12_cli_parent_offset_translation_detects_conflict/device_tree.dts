/dts-v1/;
/ {
  soc {
    #address-cells = <2>;
    #size-cells = <2>;
    ranges;

    syscon@4000 {
      reg = <0x0 0x4000 0x0 0x1000>;

      efuse@100 {
        reg = <0x0 0x100 0x0 0x20>;
      };
    };
  };
};
