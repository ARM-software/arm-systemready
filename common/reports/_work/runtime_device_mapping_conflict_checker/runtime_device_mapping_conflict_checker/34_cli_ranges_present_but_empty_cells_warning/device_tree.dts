/dts-v1/;
/ {
  soc {
    #address-cells = <2>;
    #size-cells = <2>;
    ranges;

    bus@0 {
      #address-cells = <2>;
      #size-cells = <2>;
      ranges = <>;

      uart@2000 {
        reg = <0x0 0x2000 0x0 0x100>;
      };
    };
  };
};
