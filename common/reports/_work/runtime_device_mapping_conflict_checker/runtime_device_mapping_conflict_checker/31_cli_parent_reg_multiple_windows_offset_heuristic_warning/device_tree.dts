/dts-v1/;
/ {
  soc {
    #address-cells = <2>;
    #size-cells = <2>;
    ranges;

    syscon@4000 {
      reg = <0x0 0x4000 0x0 0x100 0x0 0x8000 0x0 0x100>;

      efuse@80 {
        reg = <0x0 0x80 0x0 0x20>;
      };
    };
  };
};
