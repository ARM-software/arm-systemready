/dts-v1/;
/* block comment */
/ {
  soc {
    #address-cells = <2>; // inline comment
    #size-cells = <2>;
    ranges;
    uart@3000 {
      reg = <0x0 0x3000 0x0 0x100>; // end of line comment
    };
  };
};
